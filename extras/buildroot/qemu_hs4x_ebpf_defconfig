## extras/buildroot/qemu_hs4x_ebpf_defconfig
```kconfig
BR2_arcle=y
BR2_archs38=y
BR2_TOOLCHAIN_EXTERNAL=y
BR2_TOOLCHAIN_EXTERNAL_CUSTOM=y
BR2_TOOLCHAIN_EXTERNAL_PATH="/tools/arc-linux-gnu"
BR2_TOOLCHAIN_EXTERNAL_CUSTOM_PREFIX="$(ARCH)-linux-gnu"
BR2_TOOLCHAIN_EXTERNAL_HEADERS_5_16=y
BR2_TOOLCHAIN_EXTERNAL_CUSTOM_GLIBC=y
BR2_TOOLCHAIN_EXTERNAL_INET_RPC=n
BR2_TOOLCHAIN_EXTERNAL_CXX=y
BR2_TOOLCHAIN_EXTERNAL_GDB_SERVER_COPY=y
BR2_ENABLE_DEBUG=y
BR2_DEBUG_3=y
BR2_OPTIMIZE_G=y
BR2_TARGET_GENERIC_HOSTNAME="archs"
BR2_TARGET_ROOTFS_CPIO=y
BR2_SYSTEM_DHCP="eth0"
BR2_ROOTFS_OVERLAY="build/overlay"
BR2_ROOTFS_DEVICE_TABLE="build/device_table.txt"
BR2_ROOTFS_USERS_TABLES="build/users_table.txt"
BR2_PACKAGE_BUSYBOX_CONFIG_FRAGMENT_FILES="build/busybox.fragment"
BR2_PACKAGE_NCURSES=y
BR2_PACKAGE_NCURSES_WCHAR=y
BR2_PACKAGE_HAVEGED=y
BR2_PACKAGE_RSYNC=y
BR2_PACKAGE_HOST_KMOD=y
BR2_PACKAGE_LIBBPF=y
BR2_PACKAGE_BPFTOOL=y
BR2_PACKAGE_ELFUTILS=y
BR2_PACKAGE_OPENSSH=y
BR2_PACKAGE_NFS_UTILS=y
BR2_PACKAGE_SSHFS=y
BR2_PACKAGE_MAKE=y
```
